#include <WiFi.h>
#include <HTTPClient.h>
#include <ArduinoJson.h>
#include <Adafruit_GFX.h>
#include <Adafruit_SH110X.h>
// #pragma once
// #define 44TT0Y_BMPWIDTH  32
#define SCREEN_WIDTH 128
#define SCREEN_HEIGHT 64

Adafruit_SH1106G display(SCREEN_WIDTH, SCREEN_HEIGHT, &Wire, -1);

// WiFi credentials
const char* ssid = "Hacked";
const char* password = "25june2004";

// OpenWeatherMap API
const String city = "Pune";
const String countryCode = "IN";
const String apiKey = "b12063ea5512f9cf0a836cf94fe512e6";

// Weather data
String cityName = "--";
String description = "--";
float temp = 0.0;
int humidity = 0;
float windSpeed = 0.0;
int pressure = 0;


const unsigned char cityIcon [] PROGMEM = {
  0x00,0x00,0x00,0x00, // ...............................#
  0x00,0x00,0x00,0x00, // ...............................#
  0x00,0x00,0x00,0x00, // ...............................#
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  0x00,0x00,0x00,0x00  // ...............................#
};


const unsigned char tempIcon [] PROGMEM = {
  0x00,0x06,0x00,0x00, // .............##.................
  0x00,0x1F,0x80,0x00, // ...........######...............
  0x00,0x19,0xC0,0x00, // ...........##..###..............
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  0x00,0x00,0x00,0x00  // ..............#.................
};


const unsigned char humidityIcon [] PROGMEM = {
  0x00,0x00,0x00,0x00, // ................................
  0x00,0x00,0x00,0x00, // ................................
  0x00,0x00,0x00,0x00, // ................................
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  0x00,0x00,0x00,0x00  // ................................
};

const unsigned char pressureIcon [] PROGMEM = {
  0x00,0x00,0x00,0x00, // ................................
  0x00,0x00,0x00,0x00, // ................................
  0x00,0x00,0x00,0x00, // ................................
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  0x00,0x00,0x00,0x00  // ................................
};

const unsigned char windIcon [] PROGMEM = {
  0x00,0x00,0x00,0x00, // ................................
  0x00,0x00,0x00,0x00, // ................................
  0x00,0x00,0x00,0x00, // ................................
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  0x00,0x00,0x00,0x00  // ................................
};

void setup() {
  Serial.begin(115200);
  display.begin(0x3C, true);
  display.clearDisplay();
  display.setTextColor(SH110X_WHITE);
  display.setTextSize(1);
  display.setCursor(0, 0);
  display.println("Connecting WiFi...");
  display.display();

  WiFi.begin(ssid, password);
  while (WiFi.status() != WL_CONNECTED) {
    delay(500);
    Serial.print(".");
  }

  display.clearDisplay();
  display.setCursor(0, 0);
  display.println("WiFi Connected!");
  display.display();
  delay(1000);
}

void loop() {
  if (WiFi.status() == WL_CONNECTED) {
    HTTPClient http;
    String url = "http://api.openweathermap.org/data/2.5/weather?q=" + city + "," + countryCode + "&units=metric&appid=" + apiKey;
    http.begin(url);
    int code = http.GET();

    if (code > 0) {
      String payload = http.getString();
      StaticJsonDocument<1024> doc;
      DeserializationError error = deserializeJson(doc, payload);

      if (!error) {
        cityName = doc["name"].as<String>();
        temp = doc["main"]["temp"].as<float>();
        humidity = doc["main"]["humidity"].as<int>();
        description = doc["weather"][0]["main"].as<String>();
        windSpeed = doc["wind"]["speed"].as<float>();
        pressure = doc["main"]["pressure"].as<int>();
      }
    }
    http.end();
  }

  showWeatherPages();
  delay(10000);  // Refresh every 10 seconds
}

void showWeatherPages() {
  showPage("City", cityName, cityIcon);
  showPage("Temprature", String(temp, 1) + " C", tempIcon);
  showPage("Humidity", String(humidity) + " %", humidityIcon);
  showPage("Weather", description, NULL);
  showPage("Wind", String(windSpeed, 1) + " m/s", windIcon);
  showPage("Pressure", String(pressure) + " hPa", pressureIcon);
}

void showPage(String title, String value, const unsigned char* icon) {
  display.clearDisplay();
  display.setTextSize(1);
  display.setCursor(30,0);
  display.println("City Weather");

  display.setCursor(10, 20);
  display.println(title + ":-");

  display.setCursor(10, 40);
  display.setTextSize(1);
  display.println(value);

  if (icon != NULL) {
    display.drawBitmap(80, 20, icon, 32, 32, SH110X_WHITE);
  }

  display.display();
  delay(4000);
}
