#include <WiFi.h>
#include <HTTPClient.h>
#include <ArduinoJson.h>
#include <Adafruit_GFX.h>
#include <Adafruit_SH110X.h>

#define SCREEN_WIDTH 128
#define SCREEN_HEIGHT 64

Adafruit_SH1106G display(SCREEN_WIDTH, SCREEN_HEIGHT, &Wire, -1);

// WiFi credentials
const char* ssid = "Hacked";
const char* password = "25june2004";

// Location settings
String city = "Pune";         // <-- User can change this
String countryCode = "IN";      // <-- User can change this
String apiKey = "b12063ea5512f9cf0a836cf94fe512e6";

// --- ICONS GO HERE ---
const unsigned char cityIcon [] PROGMEM = {
  0x00,0x00,0x00,0x00, // ...............................#
  0x00,0x00,0x00,0x00, // ...............................#
  0x00,0x00,0x00,0x00, // ...............................#
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  0x00,0x00,0x00,0x00  // ...............................#
};


const unsigned char tempIcon [] PROGMEM = {
  0x00,0x06,0x00,0x00, // .............##.................
  0x00,0x1F,0x80,0x00, // ...........######...............
  0x00,0x19,0xC0,0x00, // ...........##..###..............
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  0x00,0x00,0x00,0x00  // ..............#.................
};


const unsigned char humidityIcon [] PROGMEM = {
  0x00,0x00,0x00,0x00, // ................................
  0x00,0x00,0x00,0x00, // ................................
  0x00,0x00,0x00,0x00, // ................................
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  0x00,0x00,0x00,0x00  // ................................
};

const unsigned char pressureIcon [] PROGMEM = {
  0x00,0x00,0x00,0x00, // ................................
  0x00,0x00,0x00,0x00, // ................................
  0x00,0x00,0x00,0x00, // ................................
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  0x00,0x00,0x00,0x00  // ................................
};

const unsigned char windIcon [] PROGMEM = {
  0x00,0x00,0x00,0x00, // ................................
  0x00,0x00,0x00,0x00, // ................................
  0x00,0x00,0x00,0x00, // ................................
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  0x00,0x00,0x00,0x00  // ................................
};

const unsigned char clearSky [] PROGMEM = {
  0x00,0x00,0x00,0x00, // ................................
  0x00,0x0C,0x00,0x00, // ............##..................
  0x00,0x0C,0x00,0x00, // ............##..................
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  0x00,0x00,0x00,0x00  // ................................
};

const unsigned char cloudRain [] PROGMEM = {
  0x00,0x00,0x00,0x00, // ................................
  0x00,0x00,0x00,0x00, // ................................
  0x00,0x03,0xC0,0x00, // ..............####..............
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  0x00,0x00,0x00,0x00  // ................................
};

const unsigned char thunderStorm [] PROGMEM = {
  0x00,0x00,0x00,0x00, // ................................
  0x00,0x1F,0xE0,0x00, // ...........########.............
  0x00,0x7F,0xF0,0x00, // .........###########............
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  0x00,0x00,0x00,0x00  // ................................
};

const unsigned char fog [] PROGMEM = {
  0x00,0x00,0x00,0x00, // ................................
  0x00,0x00,0x00,0x00, // ................................
  0x00,0x00,0x00,0x00, // ................................
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  0x00,0x00,0x00,0x00  // ................................
};

const unsigned char mist [] PROGMEM = {
  0x00,0x00,0x00,0x00, // ................................
  0x00,0x00,0x00,0x00, // ................................
  0x00,0x00,0x00,0x00, // ................................
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  0x00,0x00,0x00,0x00  // ................................
};


const unsigned char cloudIcon[] PROGMEM = {
  0x00,0x00,0x00,0x00, // ................................
  0x00,0x00,0x00,0x00, // ................................
  0x00,0x00,0x00,0x00, // ................................
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  0x00,0x00,0x00,0x00  // ................................
};


int currentPage = 0;
const int totalPages = 6;

String cityName, description;
float temp, windSpeed, pressure, humidity;

void setup() {
  Serial.begin(115200);
  display.begin(0x3C, true);
  display.display();
  delay(3000);
  display.clearDisplay();

  WiFi.begin(ssid, password);
  display.setCursor(0, 0);
  display.println("Connecting to WiFi...");
  display.display();

  while (WiFi.status() != WL_CONNECTED) {
    delay(500);
    Serial.print(".");
  }

  display.clearDisplay();
  display.setCursor(0, 0);
  display.println("WiFi connected!");
  display.display();

  getWeatherData();
}

void loop() {
  display.clearDisplay();

  switch (currentPage) {
    case 0:
      showPage("City", cityName, cityIcon, currentPage);
      break;
    case 1:
      showPage("Temperature", String(temp, 1) + " C", tempIcon, currentPage);
      break;
    case 2:
      showPage("Weather", description, getWeatherIcon(description), currentPage);
      break;
    case 3:
      showPage("Humidity", String(humidity) + " %", humidityIcon, currentPage);
      break;
    case 4:
      showPage("Wind", String(windSpeed, 1) + " m/s", windIcon, currentPage);
      break;
    case 5:
      showPage("Pressure", String(pressure) + " hPa", pressureIcon, currentPage);
      break;
  }

  currentPage = (currentPage + 1) % totalPages;
  delay(3000); // Delay between page switches
}

void getWeatherData() {
  if (WiFi.status() == WL_CONNECTED) {
    HTTPClient http;
    String url = "http://api.openweathermap.org/data/2.5/weather?q=" + city + "," + countryCode + "&appid=" + apiKey + "&units=metric";
    http.begin(url);
    int httpCode = http.GET();

    if (httpCode == 200) {
      String payload = http.getString();
      Serial.println(payload);
      DynamicJsonDocument doc(1024);
      deserializeJson(doc, payload);

      cityName = doc["name"].as<String>();
      temp = doc["main"]["temp"].as<float>();
      pressure = doc["main"]["pressure"].as<float>();
      humidity = doc["main"]["humidity"].as<float>();
      windSpeed = doc["wind"]["speed"].as<float>();
      description = doc["weather"][0]["description"].as<String>();
    } else {
      Serial.println("Failed to fetch weather data");
    }

    http.end();
  } else {
    Serial.println("WiFi not connected");
  }
}

void drawHeader() {
    display.setCursor(30, 0);  // 🟢 Title moved UP
    display.setTextSize(1);
    display.println("City Weather");
    display.drawLine(0, 10, SCREEN_WIDTH, 10, SH110X_WHITE);
}

void showPage(const String& title, const String& data, const uint8_t* icon, int pageIndex) {
  display.clearDisplay();

  display.setTextSize(1);
  display.setTextColor(SH110X_WHITE);
  display.setCursor(2, 17);
  display.println(title + ":");

  display.drawBitmap(85, 16, icon, 32, 32, SH110X_WHITE);

  display.setCursor(2, 33);
  display.setTextSize(1);
  display.println(data);

  drawHeader();
  drawFooter(pageIndex);
  display.display();
}

void drawFooter(int currentPage) {
  display.drawLine(0, 50, SCREEN_WIDTH, 50, SH110X_WHITE);
  int dotRadius = 2;
  int spacing = 10;
  int startX = (SCREEN_WIDTH - spacing * (totalPages - 1)) / 2;
  int y = SCREEN_HEIGHT - 6;

  for (int i = 0; i < totalPages; i++) {
    if (i == currentPage) {
      display.fillCircle(startX + i * spacing, y, dotRadius, SH110X_WHITE);
    } else {
      display.drawCircle(startX + i * spacing, y, dotRadius, SH110X_WHITE);
    }
  }
}

const uint8_t* getWeatherIcon(String desc) {
  desc.toLowerCase();
  if (desc.indexOf("clear") != -1) return clearSky;
  if (desc.indexOf("rain") != -1) return cloudRain;
  if (desc.indexOf("thunder") != -1) return thunderStorm;
  if (desc.indexOf("fog") != -1) return fog;
  if (desc.indexOf("mist") != -1) return mist;
  return cloudIcon; // default
}
