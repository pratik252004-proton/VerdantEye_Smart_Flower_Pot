#include <WiFi.h>
#include <HTTPClient.h>
#include <ArduinoJson.h>
#include <Adafruit_GFX.h>
#include <Adafruit_SH110X.h>

#define SCREEN_WIDTH 128
#define SCREEN_HEIGHT 64

Adafruit_SH1106G display(SCREEN_WIDTH, SCREEN_HEIGHT, &Wire, -1);

// WiFi credentials
const char* ssid = "Hacked";
const char* password = "25june2004";

// OpenWeatherMap API
const String city = "Pune";
const String countryCode = "IN";
const String apiKey = "b12063ea5512f9cf0a836cf94fe512e6";

// Weather data
String cityName = "--";
String description = "--";
float temp = 0.0;
int humidity = 0;
float windSpeed = 0.0;
int pressure = 0;

const int totalPages = 6;

// --- ICONS GO HERE ---
const unsigned char cityIcon [] PROGMEM = {
  0x00,0x00,0x00,0x00, // ...............................#
  0x00,0x00,0x00,0x00, // ...............................#
  0x00,0x00,0x00,0x00, // ...............................#
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  0x00,0x00,0x00,0x00  // ...............................#
};


const unsigned char tempIcon [] PROGMEM = {
  0x00,0x06,0x00,0x00, // .............##.................
  0x00,0x1F,0x80,0x00, // ...........######...............
  0x00,0x19,0xC0,0x00, // ...........##..###..............
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  0x00,0x00,0x00,0x00  // ..............#.................
};


const unsigned char humidityIcon [] PROGMEM = {
  0x00,0x00,0x00,0x00, // ................................
  0x00,0x00,0x00,0x00, // ................................
  0x00,0x00,0x00,0x00, // ................................
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  0x00,0x00,0x00,0x00  // ................................
};

const unsigned char pressureIcon [] PROGMEM = {
  0x00,0x00,0x00,0x00, // ................................
  0x00,0x00,0x00,0x00, // ................................
  0x00,0x00,0x00,0x00, // ................................
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  0x00,0x00,0x00,0x00  // ................................
};

const unsigned char windIcon [] PROGMEM = {
  0x00,0x00,0x00,0x00, // ................................
  0x00,0x00,0x00,0x00, // ................................
  0x00,0x00,0x00,0x00, // ................................
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  0x00,0x00,0x00,0x00  // ................................
};

const unsigned char clearSky [] PROGMEM = {
  0x00,0x00,0x00,0x00, // ................................
  0x00,0x0C,0x00,0x00, // ............##..................
  0x00,0x0C,0x00,0x00, // ............##..................
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  0x00,0x00,0x00,0x00  // ................................
};


const unsigned char cloudRain [] PROGMEM = {
  0x00,0x00,0x00,0x00, // ................................
  0x00,0x00,0x00,0x00, // ................................
  0x00,0x03,0xC0,0x00, // ..............####..............
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  0x00,0x00,0x00,0x00  // ................................
};

const unsigned char thunderStrom [] PROGMEM = {
  0x00,0x00,0x00,0x00, // ................................
  0x00,0x1F,0xE0,0x00, // ...........########.............
  0x00,0x7F,0xF0,0x00, // .........###########............
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  0x00,0x00,0x00,0x00  // ................................
};


const unsigned char fog [] PROGMEM = {
  0x00,0x00,0x00,0x00, // ................................
  0x00,0x00,0x00,0x00, // ................................
  0x00,0x00,0x00,0x00, // ................................
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  0x00,0x00,0x00,0x00  // ................................
};

const unsigned char mist [] PROGMEM = {
  0x00,0x00,0x00,0x00, // ................................
  0x00,0x00,0x00,0x00, // ................................
  0x00,0x00,0x00,0x00, // ................................
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  0x00,0x00,0x00,0x00  // ................................
};

void setup() {
  Serial.begin(115200);
  display.begin(0x3C, true);
  display.clearDisplay();
  display.setTextColor(SH110X_WHITE);
  display.setTextSize(1);
  display.setCursor(0, 0);
  display.println("Connecting WiFi...");
  display.display();

  WiFi.begin(ssid, password);
  while (WiFi.status() != WL_CONNECTED) {
    delay(500);
    Serial.print(".");
  }

  display.clearDisplay();
  display.setCursor(0, 0);
  display.println("WiFi Connected!");
  display.display();
  delay(1000);
}

void loop() {
  if (WiFi.status() == WL_CONNECTED) {
    HTTPClient http;
    String url = "http://api.openweathermap.org/data/2.5/weather?q=" + city + "," + countryCode + "&units=metric&appid=" + apiKey;
    http.begin(url);
    int code = http.GET();

    if (code > 0) {
      String payload = http.getString();
      StaticJsonDocument<1024> doc;
      DeserializationError error = deserializeJson(doc, payload);

      if (!error) {
        cityName = doc["name"].as<String>();
        temp = doc["main"]["temp"].as<float>();
        humidity = doc["main"]["humidity"].as<int>();
        description = doc["weather"][0]["main"].as<String>();
        windSpeed = doc["wind"]["speed"].as<float>();
        pressure = doc["main"]["pressure"].as<int>();
      }
    }
    http.end();
  }

  showWeatherPages();
  delay(10000);  // Refresh every 10 seconds
}

// --- Helper Functions for Header and Footer ---

void drawHeader() {
    display.setCursor(30, 0);  // 🟢 Title moved UP
    display.setTextSize(1);
    display.println("City Weather");
    display.drawLine(0, 10, SCREEN_WIDTH, 10, SH110X_WHITE);
}

void drawFooter(int currentPage) {
  display.drawLine(0, 54, SCREEN_WIDTH, 54, SH110X_WHITE); // Move line UP to y=54 (was 50)

  int dotRadius = 2;
  int spacing = 10;
  int startX = (SCREEN_WIDTH - spacing * (totalPages - 1)) / 2;
  int y = SCREEN_HEIGHT -4; // Move dots DOWN (was 58), now at y=62

  for (int i = 0; i < totalPages; i++) {
    if (i == currentPage) {
      display.fillCircle(startX + i * spacing, y, dotRadius, SH110X_WHITE); // Active dot
    } else {
      display.drawCircle(startX + i * spacing, y, dotRadius, SH110X_WHITE); // Inactive dot
    }
  }
}

// --- Page Display Functions ---

void showWeatherPages() {
  int pageIndex = 0;
  showPage("City", cityName, cityIcon, pageIndex++);
  showPage("Temperature", String(temp, 1) + " C", tempIcon, pageIndex++);
  showPage("Humidity", String(humidity) + " %", humidityIcon, pageIndex++);
  showPage("Weather", description, NULL, pageIndex++);
  showPage("Wind", String(windSpeed, 1) + " m/s", windIcon, pageIndex++);
  showPage("Pressure", String(pressure) + " hPa", pressureIcon, pageIndex++);
}

void showPage(String title, String value, const unsigned char* icon, int pageIndex) {
  display.clearDisplay();

  drawHeader();
  drawFooter(pageIndex);

  display.setTextSize(1);
  display.setCursor(5, 15);
  display.println(title + ":");

  display.setTextSize(1);
  display.setCursor(5, 32);
  display.println(value);

  if (icon != NULL) {
    display.drawBitmap(80, 16, icon, 32, 32, SH110X_WHITE);
  }
  
  display.display();
  delay(4000);  // Duration each page is shown
}
